## main/Kconfig.projbuild
```kconfig
menu "Leaf display"

    choice LEAF_DISPLAY_BOARD
        prompt "Display board"
        default LEAF_DISPLAY_7_INCH

        config LEAF_DISPLAY_7_INCH
            bool "ESP32-8048S070 (7 inch)"

        config LEAF_DISPLAY_5_INCH
            bool "ESP32-8048S050 (5 inch)"
    endchoice

    choice LEAF_LCD_TIMING
        prompt "RGB LCD timing preset"
        default LEAF_LCD_TIMING_COMPARISON
        help
            Select the timing preset for the ESP32-8048S070 comparison.
            This does not change framebuffer sizes or application behavior.

        config LEAF_LCD_TIMING_BASELINE
            bool "Baseline: 16 MHz, original blanking"

        config LEAF_LCD_TIMING_COMPARISON
            bool "Comparison: LovyanGFX Sunton preset, 14 MHz"
            help
                Experimental timing comparison based on LovyanGFX's
                LGFX_Sunton_ESP32-8048S070.h. Validate on cold power-on.
    endchoice

endmenu
```
